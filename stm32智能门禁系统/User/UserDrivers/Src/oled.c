/*
 * oled.c
 *
 *  Created on: 2022年3月12日
 *      Author: Naming8104
 */
#include "oled.h"

#include "spi.h"
#include "string.h"

const uint8_t F6x8[] =
{
  0x00, 0x00, 0x00, 0x00, 0x00, 0x00, // sp
  0x00, 0x00, 0x00, 0x2f, 0x00, 0x00, // !
  0x00, 0x00, 0x07, 0x00, 0x07, 0x00, // "
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  0x14, 0x14, 0x14, 0x14, 0x14, 0x14  // horiz lines
};

//======================================================
// 128X64I液晶底层驱动[8X16]字体库
// 设计者: powerint
// 描  述: [8X16]西文字符的字模数据 (纵向取模,字节倒序)
// !"#$%&'()*+,-./0123456789:;<=>?@ABCDEFGHIJKLMNOPQRSTUVWXYZ[\]^_`abcdefghijklmnopqrstuvwxyz{|}~
//======================================================
const uint8_t F8X16[1520] =
{
  0x00, 0x00, 0x00, 0x00, 0x00, 0x00, 0x00, 0x00, 0x00, 0x00, 0x00, 0x00, 0x00, 0x00, 0x00, 0x00, // 0
  0x00, 0x00, 0x00, 0xF8, 0x00, 0x00, 0x00, 0x00, 0x00, 0x00, 0x00, 0x33, 0x30, 0x00, 0x00, 0x00, //! 1
  0x00, 0x10, 0x0C, 0x06, 0x10, 0x0C, 0x06, 0x00, 0x00, 0x00, 0x00, 0x00, 0x00, 0x00, 0x00, 0x00, //"2
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  0x00, 0x06, 0x01, 0x01, 0x02, 0x02, 0x04, 0x04, 0x00, 0x00, 0x00, 0x00, 0x00, 0x00, 0x00, 0x00, //~94
};

static const char *F16x16_Idx = "修下再功密成手指按改次码确纹解认请锁开门中…太短重试不一致";

static const uint8_t F16x16[] = {

  0x40, 0x20, 0xf8, 0x07, 0xf0, 0xa0, 0x90, 0x4c, 0x57, 0x24, 0xa4, 0x54, 0x4c, 0x80, 0x80, 0x00, 
  0x00, 0x00, 0xff, 0x00, 0x1f, 0x80, 0x92, 0x52, 0x49, 0x29, 0x24, 0x12, 0x08, 0x00, 0x00, 0x00, //修 0

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  0x40, 0xc4, 0x44, 0x7f, 0x24, 0x24, 0xa0, 0x40, 0x21, 0x16, 0x08, 0x16, 0x21, 0x40, 0x80, 0x00 //致 28

};

/* 生成实心菱形图标的16*16点阵*/
const uint8_t nonside[32] =
{
  0x80, 0xc0, 0xe0, 0xf0, 0xf8, 0xfc, 0xfe, 0xff, 0xfe, 0xfc, 0xf8, 0xf0, 0xe0, 0xc0, 0x80, 0x00, 
  0x00, 0x01, 0x03, 0x07, 0x0f, 0x1f, 0x3f, 0x7f, 0x3f, 0x1f, 0x0f, 0x07, 0x03, 0x01, 0x00, 0x00 //◆0,
};

void OLED_WrDat(uint8_t data)
{
  OLED_DC_SET();//数据
  HAL_SPI_Transmit(&hspi2, &data, 1, 1);
}
void OLED_WrCmd(uint8_t cmd)
{
  OLED_DC_CLR();//命令
  HAL_SPI_Transmit(&hspi2, &cmd, 1, 1);
}
void OLED_Start_DMA(uint8_t data[8][128], size_t size)
{
  OLED_DC_SET();//数据
  HAL_SPI_Transmit_DMA(&hspi2, (uint8_t *)data, size);
}
void OLED_Stop_DMA()
{
  HAL_SPI_DMAStop(&hspi2);
}

void OLED_Init(void)
{
  //复位
  OLED_RST_CLR();
  HAL_Delay(50);
  OLED_RST_SET();

  OLED_WrCmd(0xae); //--关闭面板（睡眠模式）
  OLED_WrCmd(0x20); OLED_WrCmd(0x02); //--设置 Page Addressing Mode (0x00/0x01/0x02)
  OLED_WrCmd(0xa1); //--设置左右反转（0xa0左右反置 0xa1正常）
  OLED_WrCmd(0xa6); //--设置正常/反色显示（0xa6正常/0xa7反色）
  OLED_WrCmd(0xa8); OLED_WrCmd(0x3f); //--设置多路复用率(0x0f~0x03f)
  OLED_WrCmd(0xb0); //--设置 Page Addressing Mode 的页开始地址(0xb0~0xb7)
  OLED_WrCmd(0xc8); //--设置上下反转（0xc0上下反置 0xc8正常）
  OLED_WrCmd(0x8d); OLED_WrCmd(0x14);//--设置电荷泵的打开与关闭（0x10关闭 0x14打开）
  // OLED_WrCmd(0x00); //---set low column address
  // OLED_WrCmd(0x10); //---set high column address
  OLED_WrCmd(0x40); //--set start line address  Set Mapping RAM Display Start Line (0x40~0x7F)
  OLED_WrCmd(0x81); OLED_WrCmd(0x01); //--设置对比度（亮度）（0x00~0xFF，RST：0x7F）
  OLED_WrCmd(0xd3); OLED_WrCmd(0x00); //-set display offset	Shift Mapping RAM Counter (0x00~0x3F)
  OLED_WrCmd(0xd5); OLED_WrCmd(0x80); //--set display clock divide ratio/oscillator frequency
  // OLED_WrCmd(0xd9); OLED_WrCmd(0x22); //--set Pre-Charge Period
  // OLED_WrCmd(0xda); OLED_WrCmd(0x12);//--set com pins hardware configuration
  // OLED_WrCmd(0xdb); OLED_WrCmd(0x40); //--set VCOMH Deselect Level
  // OLED_WrCmd(0xa4); //--关闭强制点亮整个面板 (0xa4继续显示/0xa5强制点亮)
  OLED_WrCmd(0xaf); //--打开面板
  OLED_Fill(0x00);  //初始清屏
  OLED_Set_Pos(0, 0);
}

void OLED_UpsideDown(uint8_t upside_down)
{
  if (upside_down)
    OLED_WrCmd(0xc0); //上下反置
  else
    OLED_WrCmd(0xc8); //正常
}

void OLED_AddressMode(uint8_t address_mode)
{
  OLED_WrCmd(0x20);
  if (address_mode == 0)
    OLED_WrCmd(0x00);//Horizontal addressing mode
  else if (address_mode == 1)
    OLED_WrCmd(0x01);//Vertical addressing mode
  else
    OLED_WrCmd(0x02);//Page addressing mode
}

/*设置起始地址
 *Y轴是按8格递进的，y轴0~63，只能按8格的倍数显示，
 *因为列行式只能按8个字节进行
 */
void OLED_Set_Pos(uint8_t x, uint8_t y)
{
  OLED_WrCmd(0xb0 + (y >> 3));
  OLED_WrCmd(((x & 0xf0) >> 4) | 0x10);
  OLED_WrCmd((x & 0x0f) | 0x00);
}
void OLED_Fill(uint8_t data)
{
  uint8_t y, x;

  for (y = 0; y < 8; y++)
  {
    OLED_WrCmd(0xb0 + y);
    OLED_WrCmd(0x01);
    OLED_WrCmd(0x10);
    for (x = 0; x < 128; x++)
      OLED_WrDat(data);
  }
}
void OLED_CLS(void)
{
  OLED_Fill(0x00);
}
//==============================================================
//函数名：OLED_P6x8Str(uint8_t x,uint8_t y,uint8_t *p)
//功能描述：写入一组标准ASCII字符串
//参数：显示的位置（x,y），y为页范围0～7，要显示的字符串
//返回：无
//==============================================================
void OLED_P6x8Str(uint8_t x, uint8_t y, const char *ch)
{
  uint8_t c = 0, i = 0, j = 0;
  y *= 8;

  while (*(ch + j) != '\0')
  {
    c = *(ch + j) - 32;
    if (x > 121)
    {
      x = 0;
      y += 8;
    }
    OLED_Set_Pos(x, y);
    for (i = 0; i < 6; i++)
    {
      OLED_WrDat(*(F6x8 + c * 6 + i));
    }
    x += 6;
    j++;
  }
}
//==============================================================
//函数名：OLED_P8x16Str(uint8_t x,uint8_t y,uint8_t *p)
//功能描述：写入一组标准ASCII字符串
//参数：显示的位置（x,y），y为页范围0～7，要显示的字符串
//返回：无
//==============================================================
void OLED_P8x16Str(uint8_t x, uint8_t y, const char *ch)
{
  uint8_t c = 0, i = 0, j = 0;
  y *= 8;

  while (*(ch + j) != '\0')
  {
    c = *(ch + j) - 32;
    if (x > 120)
    {
      x = 0;
      y++;
    }
    OLED_Set_Pos(x, y);
    for (i = 0; i < 8; i++)
    {
      OLED_WrDat(*(F8X16 + c * 16 + i));
    }
    OLED_Set_Pos(x, y + 8);
    for (i = 0; i < 8; i++)
    {
      OLED_WrDat(*(F8X16 + c * 16 + i + 8));
    }
    x += 8;
    j++;
  }
}
/**
 * @brief 输出汉字字符串
 *
 * @param x 起始横坐标（0~112）
 * @param y 起始纵坐标（0~6）
 * @param ch 汉字字符串
 */
void OLED_P16x16Str(uint8_t x, uint8_t y, const char *ch)
{
  uint8_t i = 0, j, k;
  uint16_t addr;
  size_t size = strlen(ch) / 3;//UTF-8汉字占3个字节
  y *= 8;

  while (i < size)
  {
    j = k = 0;
    addr = 1;//非法字模下标表示不存在的字符
    while (F16x16_Idx[k] != '\0')
    {
      if (strncmp(F16x16_Idx + k * 3, ch + i * 3, 3) == 0)//在索引中寻找字符
      {
        addr = k * 32; //定位字模起始下标
        break;
      }
      k++;
    }
    //换行
    if (x > 112)
    {
      x = 0;
      y += 16;
    }
    if (addr != 1) // 显示汉字
    {
      OLED_Set_Pos(x, y);
      for (j = 0; j < 16; j++)
      {
        OLED_WrDat(*(F16x16 + addr));
        addr += 1;
      }
      OLED_Set_Pos(x, y + 8);
      for (j = 0; j < 16; j++)
      {
        OLED_WrDat(*(F16x16 + addr));
        addr += 1;
      }
    }
    else //不存在的字符，显示菱形
    {
      addr = 0;
      OLED_Set_Pos(x, y);
      for (j = 0; j < 16; j++)
      {
        OLED_WrDat(*(nonside + addr));
        addr += 1;
      }
      OLED_Set_Pos(x, y + 8);
      for (j = 0; j < 16; j++)
      {
        OLED_WrDat(*(nonside + addr));
        addr += 1;
      }
    }
    x += 16;
    i += 1;
  }
}
//==============================================================
//函数名： void Draw_BMP(uint8_t x,uint8_t y)
//功能描述：显示BMP图片128×64
//参数：起始点坐标(x,y),x的范围0～127，y为页的范围0～63
//返回：无
//==============================================================
void OLED_BMP(uint8_t x0, uint8_t y0, const uint8_t *bmp)
{
  uint16_t ii = 0;
  uint8_t x, y;

  OLED_Set_Pos(0, 0);
  OLED_AddressMode(0);
  for (y = y0; y < 64; y += 8)
  {
    for (x = x0; x < 128; x++)
    {
      OLED_WrDat(bmp[ii++]);
    }
  }
  OLED_AddressMode(2);
}
